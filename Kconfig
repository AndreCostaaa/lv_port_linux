## Kconfig
```kconfig
rsource "lvgl/Kconfig"

config LV_USE_DEMO_TRUCK
	bool "3D Truck Demo"
	depends on LV_USE_GLTF

config LV_USE_DEMO_WATCH
	bool "Smartwatch snapshot demo"
	depends on LV_USE_SNAPSHOT

config LV_DEMO_WATCH_USE_SNAPSHOTS
	bool "Render the watch face picker from snapshots"
	depends on LV_USE_DEMO_WATCH
	select LV_USE_SNAPSHOT
	default y
```
